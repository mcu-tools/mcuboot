## boot/zephyr/Kconfig
```kconfig
# Copyright (c) 2017-2020 Linaro Limited
# Copyright (c) 2020 Arm Limited
# Copyright (c) 2022 Legrand North America, LLC.
#
# SPDX-License-Identifier: Apache-2.0
#

mainmenu "MCUboot configuration"

source "Kconfig.zephyr"
```

## boot/zephyr/Kconfig.firmware_loader
```kconfig
# Copyright (c) 2023 Nordic Semiconductor ASA
#
# SPDX-License-Identifier: Apache-2.0

if BOOT_FIRMWARE_LOADER

menu "Firmware loader entrance methods"

menuconfig BOOT_FIRMWARE_LOADER_ENTRANCE_GPIO
	bool "GPIO"
	depends on GPIO
	help
	  Use a GPIO to enter firmware loader mode.

config BOOT_FIRMWARE_LOADER_DETECT_DELAY
	int "Serial detect pin detection delay time [ms]"
	default 0
	depends on BOOT_FIRMWARE_LOADER_ENTRANCE_GPIO
	help
	  Used to prevent the bootloader from loading on button press.
	  Useful for powering on when using the same button as
	  the one used to place the device in bootloader mode.

config BOOT_FIRMWARE_LOADER_BOOT_MODE
	bool "Check boot mode via retention subsystem"
	depends on RETENTION_BOOT_MODE
	help
	  Allows for entering firmware loader mode by using Zephyr's boot mode
	  retention system (i.e. an application must set the boot mode to stay
	  in firmware loader mode and reboot the module).

config BOOT_FIRMWARE_LOADER_NO_APPLICATION
	bool "Stay in bootloader if no application"
	help
	  Allows for entering firmware loader mode if there is no bootable
	  application that the bootloader can jump to.

config BOOT_FIRMWARE_LOADER_PIN_RESET
	bool "Check for device reset by pin"
	select HWINFO
	help
	  Checks if the module reset was caused by the reset pin and will
	  remain in bootloader firmware loader mode if it was.

endmenu

endif
```

## boot/zephyr/Kconfig.serial_recovery
```kconfig
# Copyright (c) 2017-2020 Linaro Limited
# Copyright (c) 2020 Arm Limited
# Copyright (c) 2017-2023 Nordic Semiconductor ASA
#
# SPDX-License-Identifier: Apache-2.0

menuconfig MCUBOOT_SERIAL
	bool "MCUboot serial recovery"
	default n
	select REBOOT
	select SERIAL
	select UART_INTERRUPT_DRIVEN
	select BASE64
	select CRC
	select ZCBOR
	help
	  If y, enables a serial-port based update mode. This allows
	  MCUboot itself to load update images into flash over a UART.
	  If unsure, leave at the default value.

if MCUBOOT_SERIAL

choice BOOT_SERIAL_DEVICE
	prompt "Serial device"
	default BOOT_SERIAL_UART if !BOARD_NRF52840DONGLE_NRF52840
	default BOOT_SERIAL_CDC_ACM if BOARD_NRF52840DONGLE_NRF52840

config BOOT_SERIAL_UART
	bool "UART"
	# SERIAL and UART_INTERRUPT_DRIVEN already selected
	help
	  The serial device to use will be fist selected via chosen
	  node "zephyr,uart-mcumgr", when such node does not exist
	  the "zephyr,console" is used.  In case when
	  the "zephyr,uart-mcumgr" points to the same device as
	  the "zephyr,console" compilation error will be triggered.

config BOOT_SERIAL_CDC_ACM
	bool "CDC ACM"
	select USB_DEVICE_STACK
	help
	  This setting will choose CDC ACM for serial recovery unless chosen
	  "zephyr,uart-mcumgr" is present, in which case the chosen takes
	  precedence and redirects serial recovery to uart pointed by
	  the chosen, leaving console on CDC ACM.

endchoice

config MCUBOOT_SERIAL_DIRECT_IMAGE_UPLOAD
	bool "Allow to select image number for DFU"
	depends on !SINGLE_APPLICATION_SLOT
	help
	  With the option enabled, the mcuboot serial recovery will
	  respect the "image" field in mcumgr image update frame
	  header.
	  The mapping of image number to partition is as follows:
	    0 -> default behaviour, same as 1;
	    1 -> image-0 (primary slot of the first image);
	    2 -> image-1 (secondary slot of the first image);
	    3 -> image-2;
	    4 -> image-3.
	  Note that 0 is default upload target when no explicit
	  selection is done.

config BOOT_SERIAL_UNALIGNED_BUFFER_SIZE
	int "Stack buffer for unaligned memory writes"
	default 64
	range 0 128
	help
	  Specifies the stack usage for a buffer which is used for unaligned
	  memory access when data is written to a device with memory alignment
	  requirements. Set to 0 to disable.

config BOOT_MAX_LINE_INPUT_LEN
	int "Maximum input line length"
	default 128
	help
	  Maximum length of input serial port buffer (SMP serial transport uses
	  fragments of 128-bytes, this should not need to be changed unless a
	  different value is used for the transport).

config BOOT_LINE_BUFS
	int "Number of receive buffers"
	range 2 128
	default 8
	help
	  Number of receive buffers for data received via the serial port.

config BOOT_SERIAL_MAX_RECEIVE_SIZE
	int "Maximum command line length"
	default 1024
	help
	  Maximum length of received commands via the serial port (this should
	  be equal to the maximum line length, BOOT_MAX_LINE_INPUT_LEN times
	  by the number of receive buffers, BOOT_LINE_BUFS to allow for
	  optimal data transfer speeds).

config BOOT_ERASE_PROGRESSIVELY
	bool "Erase flash progressively when receiving new firmware"
	default y if SOC_FAMILY_NRF
	help
	 If enabled, flash is erased as necessary when receiving new firmware,
	 instead of erasing the whole image slot at once. This is necessary
	 on some hardware that has long erase times, to prevent long wait
	 times at the beginning of the DFU process.

config BOOT_MGMT_ECHO
	bool "Enable echo command"
	help
	  if enabled, support for the mcumgr echo command is being added.

menuconfig ENABLE_MGMT_PERUSER
	bool "Enable system specific mcumgr commands"
	help
	  The option enables processing of system specific mcumgr commands;
	  system specific commands are within group MGMT_GROUP_ID_PERUSER (64)
	  and above, as defined within mcumgr library.
	  These are system specific command and system specific implementation
	  function is required to process these commands.

if ENABLE_MGMT_PERUSER

config BOOT_MGMT_CUSTOM_STORAGE_ERASE
	bool "Enable storage erase command"
	help
	  The option enables mcumgr command that allows to erase storage
	  partition.
	  Note that the storage partition needs to be defined, in DTS, otherwise
	  enabling the option will cause a compilation to fail.

config BOOT_MGMT_CUSTOM_IMG_LIST
	bool "Enable custom image list command"
	help
	  The option enables command which returns versions and installation
	  statuses (custom property) for all images.

endif # ENABLE_MGMT_PERUSER

config BOOT_SERIAL_ENCRYPT_EC256
	bool "Support for encrypted upgrade images using ECIES-P256 in serial recovery upload"
	default n
	help
	  If y, uploaded images via serial recovery can be decrypted
	  on the fly when upgrading to the primary slot. The
	  encryption mechanism used in this case is ECIES using primitives
	  described under "ECIES-P256 encryption" in docs/encrypted_images.md.

menu "Entrance methods"

menuconfig BOOT_SERIAL_ENTRANCE_GPIO
	bool "GPIO"
	default y
	depends on GPIO
	help
	  Use a GPIO to enter serial recovery mode.

config BOOT_SERIAL_DETECT_DELAY
	int "Serial detect pin detection delay time [ms]"
	default 0
	depends on BOOT_SERIAL_ENTRANCE_GPIO
	help
	  Used to prevent the bootloader from loading on button press.
	  Useful for powering on when using the same button as
	  the one used to place the device in bootloader mode.

menuconfig BOOT_SERIAL_WAIT_FOR_DFU
	bool "Wait a prescribed duration to see if DFU is invoked by receiving a MCUmgr comand"
	depends on BOOT_SERIAL_UART || BOOT_SERIAL_CDC_ACM
	help
	  If y, MCUboot waits for a prescribed duration of time to allow
	  for DFU to be invoked. The serial recovery can be entered by receiving any
	  mcumgr command.

config BOOT_SERIAL_WAIT_FOR_DFU_TIMEOUT
	int "Duration to wait for the serial DFU timeout in ms"
	default 500
	depends on BOOT_SERIAL_WAIT_FOR_DFU
	help
	  Timeout in ms for MCUboot to wait to allow for DFU to be invoked.

config BOOT_SERIAL_BOOT_MODE
	bool "Check boot mode via retention subsystem"
	depends on RETENTION_BOOT_MODE
	help
	  Allows for entering serial recovery mode by using Zephyr's boot mode
	  retention system (i.e. an application must set the boot mode to stay
	  in serial recovery mode and reboot the module).

config BOOT_SERIAL_NO_APPLICATION
	bool "Stay in bootloader if no application"
	help
	  Allows for entering serial recovery mode if there is no bootable
	  application that the bootloader can jump to.

config BOOT_SERIAL_PIN_RESET
	bool "Check for device reset by pin"
	select HWINFO
	help
	  Checks if the module reset was caused by the reset pin and will
	  remain in bootloader serial recovery mode if it was.

endmenu

config BOOT_SERIAL_IMG_GRP_HASH
	bool "Image list hash support"
	default y
	help
	  If y, image list responses will include the image hash (adds ~100
	  bytes of flash).

config BOOT_SERIAL_IMG_GRP_IMAGE_STATE
	bool "Image state support"
	depends on !SINGLE_APPLICATION_SLOT
	select BOOT_SERIAL_IMG_GRP_HASH if UPDATEABLE_IMAGE_NUMBER > 1
	help
	  If y, image states will be included with image lists and the set
	  state command can be used to mark an image as test/confirmed.

endif # MCUBOOT_SERIAL
```

## boot/zephyr/Kconfig.usb_dfu
```kconfig
# Copyright (c) 2017-2020 Linaro Limited
# Copyright (c) 2020 Arm Limited
# Copyright (c) 2017-2022 Nordic Semiconductor ASA
#
# SPDX-License-Identifier: Apache-2.0

config BOOT_USB_DFU
	select USB_DEVICE_STACK
	select USB_DFU_CLASS
	select IMG_MANAGER
	bool

choice BOOT_USB_DFU_CHOICE
	prompt "USB DFU"
	default BOOT_USB_DFU_NO

config BOOT_USB_DFU_NO
	prompt "Disabled"

config BOOT_USB_DFU_WAIT
	bool "Wait for a prescribed duration to see if USB DFU is invoked"
	select BOOT_USB_DFU
	help
	  If y, MCUboot waits for a prescribed duration of time to allow
	  for USB DFU to be invoked. Please note DFU always updates the
	  slot1 image.

config BOOT_USB_DFU_GPIO
	bool "Use GPIO to detect whether to trigger DFU mode"
	select BOOT_USE_MODE_GPIO
	select BOOT_USB_DFU
	help
	  If y, MCUboot uses GPIO to detect whether to invoke USB DFU.
	  If CONFIG_MCUBOOT_BOOT_MODE_API is selected then USB DFU can be
	  invoked on application's request as well.

config BOOT_USB_DFU_BY_APP
	bool "Exclusively detect whether the application requested the DFU mode"
	select BOOT_USB_DFU
	select MCUBOOT_BOOT_MODE_API
	help
	  If y, MCUboot checks whether the application requested the DFU and
	  invokes USB DFU if so.

endchoice

config BOOT_USB_DFU_WAIT_DELAY_MS
	int "USB DFU wait duration"
	depends on BOOT_USB_DFU_WAIT
	default 12000
	help
	  Milliseconds to wait for USB DFU to be invoked.

if BOOT_USB_DFU_GPIO

config BOOT_USB_DFU_DETECT_PORT
	string "GPIO device to trigger USB DFU mode"
	default GPIO_0 if SOC_FAMILY_NRF
	help
	  Zephyr GPIO device that contains the pin used to trigger
	  USB DFU.

config BOOT_USB_DFU_DETECT_PIN
	int "Pin to trigger USB DFU mode"
	default 6 if BOARD_NRF9160DK_NRF9160
	default 11 if BOARD_NRF52840DK_NRF52840
	default 13 if BOARD_NRF52DK_NRF52832
	default 23 if BOARD_NRF5340_DK_NRF5340_CPUAPP || BOARD_NRF5340_DK_NRF5340_CPUAPP_NS
	default 43 if BOARD_BL5340_DVK_CPUAPP || BOARD_BL5340_DVK_CPUAPP_NS
	help
	  Pin on the DFU detect port that triggers DFU mode.

config BOOT_USB_DFU_DETECT_PIN_VAL
	int "USB DFU detect pin trigger value"
	default 0
	range 0 1
	help
	  Logic value of the detect pin that triggers USB DFU mode.

config BOOT_USB_DFU_DETECT_DELAY
	int "Serial detect pin detection delay time [ms]"
	default 0
	help
	  Used to prevent the bootloader from loading on button press.
	  Useful for powering on when using the same button as
	  the one used to place the device in bootloader mode.

endif # BOOT_USB_DFU_GPIO
```

## boot/zephyr/boards/actinius_icarus.conf
```kconfig
# Disable Zephyr console
CONFIG_CONSOLE=n

# MCUBoot settings
CONFIG_BOOT_MAX_IMG_SECTORS=256

# MCUboot serial recovery
CONFIG_MCUBOOT_SERIAL=y
CONFIG_BOOT_SERIAL_DETECT_PORT="GPIO_0"
CONFIG_BOOT_SERIAL_DETECT_PIN=5
CONFIG_BOOT_SERIAL_DETECT_PIN_VAL=0
```

## boot/zephyr/boards/actinius_icarus_bee_nrf9160.conf
```kconfig
# Disable Zephyr console
CONFIG_CONSOLE=n

# MCUboot serial recovery
CONFIG_MCUBOOT_SERIAL=y
```

## boot/zephyr/boards/circuitdojo_feather_nrf9160.conf
```kconfig
# Disable Zephyr console
CONFIG_CONSOLE=n

# MCUboot serial recovery
CONFIG_MCUBOOT_SERIAL=y
CONFIG_BOOT_SERIAL_DETECT_DELAY=450
CONFIG_MCUBOOT_INDICATION_LED=y
```

## boot/zephyr/boards/conexio_stratus.conf
```kconfig
# Disable Zephyr console
CONFIG_CONSOLE=n
CONFIG_CONSOLE_HANDLER=n
CONFIG_UART_CONSOLE=n

# MCUboot serial recovery
CONFIG_MCUBOOT_SERIAL=y
CONFIG_BOOT_SERIAL_DETECT_DELAY=450
CONFIG_MCUBOOT_INDICATION_LED=y
```

## boot/zephyr/boards/ctcc_nrf52840.conf
```kconfig
# Disable logging
CONFIG_LOG=n
CONFIG_CONSOLE=n
CONFIG_UART_CONSOLE=n

# MCUBoot serial configuration
CONFIG_MCUBOOT_SERIAL=y
CONFIG_BOOT_SERIAL_ENTRANCE_GPIO=n
CONFIG_BOOT_SERIAL_CDC_ACM=y
CONFIG_BOOT_SERIAL_WAIT_FOR_DFU=y
CONFIG_BOOT_SERIAL_NO_APPLICATION=y
CONFIG_BOOT_SERIAL_WAIT_FOR_DFU_TIMEOUT=5000
CONFIG_BOOT_USB_DFU_WAIT=n

# Required by USB
CONFIG_MULTITHREADING=y

# USB
CONFIG_USB_DEVICE_STACK=y
CONFIG_USB_DEVICE_REMOTE_WAKEUP=n
```

## boot/zephyr/boards/ctcc_nrf9161.conf
```kconfig
# Disable logging
CONFIG_LOG=n
CONFIG_CONSOLE=n
CONFIG_UART_CONSOLE=n

# MCUboot serial configuration
CONFIG_MCUBOOT_SERIAL=y
CONFIG_BOOT_SERIAL_UART=y
CONFIG_BOOT_SERIAL_ENTRANCE_GPIO=n
CONFIG_BOOT_SERIAL_WAIT_FOR_DFU=y
CONFIG_BOOT_SERIAL_NO_APPLICATION=y
CONFIG_BOOT_SERIAL_WAIT_FOR_DFU_TIMEOUT=5000

# SPI NOR
CONFIG_SPI_NOR=n
```

## boot/zephyr/boards/flash_ext_sim_driver.conf
```kconfig
CONFIG_FLASH_SIMULATOR=y
CONFIG_FLASH_SIMULATOR_UNALIGNED_READ=y

CONFIG_NORDIC_QSPI_NOR=y
CONFIG_NORDIC_QSPI_NOR_FLASH_LAYOUT_PAGE_SIZE=4096
CONFIG_NORDIC_QSPI_NOR_STACK_WRITE_BUFFER_SIZE=16

CONFIG_BOOT_IMAGE_ACCESS_HOOKS=y
CONFIG_BOOT_IMAGE_ACCESS_HOOKS_FILE="hooks_sample.c"
```

## boot/zephyr/boards/frdm_mcxa156.conf
```kconfig
# Copyright 2024 NXP
# SPDX-License-Identifier: Apache-2.0

#MCXA156 does not support the MCUBoot swap mode.
CONFIG_BOOT_UPGRADE_ONLY=y
```

## boot/zephyr/boards/frdm_mcxn236.conf
```kconfig
# Copyright 2025 NXP
# SPDX-License-Identifier: Apache-2.0

#MCXN236 does not support the MCUBoot swap mode.
CONFIG_BOOT_UPGRADE_ONLY=y
```

## boot/zephyr/boards/frdm_mcxn947_mcxn947_cpu0.conf
```kconfig
# Copyright 2024 NXP
# SPDX-License-Identifier: Apache-2.0

#MCXN94x does not support the MCUBoot swap mode.
CONFIG_BOOT_UPGRADE_ONLY=y
```

## boot/zephyr/boards/frdm_mcxn947_mcxn947_cpu0_qspi.conf
```kconfig
# Copyright 2023 NXP
# SPDX-License-Identifier: Apache-2.0

CONFIG_BOOT_UPGRADE_ONLY=y
```

## boot/zephyr/boards/icev_wireless.conf
```kconfig
# SPDX-FileCopyrightText: 2023 Espressif Systems (Shanghai) CO LTD
# SPDX-License-Identifier: Apache-2.0

CONFIG_BOOT_MAX_IMG_SECTORS=512
CONFIG_BOOT_UPGRADE_ONLY=y
CONFIG_BOOT_VALIDATE_SLOT0=n
CONFIG_BOOT_SIGNATURE_TYPE_NONE=y
CONFIG_BOOT_BANNER=n

CONFIG_UART_CONSOLE=n
CONFIG_CONSOLE=n
CONFIG_SERIAL=n

CONFIG_DEBUG=n
CONFIG_LOG_DEFAULT_LEVEL=0

CONFIG_XIP=n
CONFIG_HEAP_MEM_POOL_SIZE=4096
CONFIG_MINIMAL_LIBC=y
```

## boot/zephyr/boards/intel_s1000_crb.conf
```kconfig
CONFIG_DEBUG=n
CONFIG_I2C=n
CONFIG_BOOT_MAX_IMG_SECTORS=512
CONFIG_BOOT_WAIT_FOR_USB_DFU=y
```

## boot/zephyr/boards/lpcxpresso55s69_lpc55s69_cpu0.conf
```kconfig
# Copyright 2023 NXP
# SPDX-License-Identifier: Apache-2.0

#LPC does not support the MCUBoot swap mode.
CONFIG_BOOT_UPGRADE_ONLY=y
CONFIG_BOOT_MAX_IMG_SECTORS=512
```

## boot/zephyr/boards/mcx_n9xx_evk_mcxn947_cpu0_qspi.conf
```kconfig
# Copyright 2025 NXP
# SPDX-License-Identifier: Apache-2.0

CONFIG_BOOT_UPGRADE_ONLY=y
```

## boot/zephyr/boards/mimxrt1024_evk_mimxrt1024.conf
```kconfig
# Copyright (c) 2021 Prevas A/S
# SPDX-License-Identifier: Apache-2.0

CONFIG_BOOT_MAX_IMG_SECTORS=512
```

## boot/zephyr/boards/mimxrt1060_evk.conf
```kconfig
# Copyright 2021-2022 NXP
# SPDX-License-Identifier: Apache-2.0

CONFIG_BOOT_MAX_IMG_SECTORS=1024
CONFIG_BOOT_ERASE_PROGRESSIVELY=y
```

## boot/zephyr/boards/mimxrt1160_evk_mimxrt1166_cm7.conf
```kconfig
# Copyright 2024 NXP
# SPDX-License-Identifier: Apache-2.0

CONFIG_BOOT_MAX_IMG_SECTORS=2048
CONFIG_BOOT_ERASE_PROGRESSIVELY=y
```
