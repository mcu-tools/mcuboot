/*
 * Copyright (c) 2024 TOKITA Hiroshi <tokita.hiroshi@gmail.com>
 *
 * SPDX-License-Identifier: Apache-2.0
 */

&aw9523b {
	status = "disabled";
};

&aw9523b_gpio {
	status = "disabled";
};

&ft6336_touch {
	status = "disabled";
};
