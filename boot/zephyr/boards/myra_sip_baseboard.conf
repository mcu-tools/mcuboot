## boot/zephyr/boards/nrf51_pca10028.conf
```kconfig
# Due the small boot partition can't use logging and debug optimalization
# out-off-the-box. For using these features need to increase boot partition via
# zephyr DTS.
CONFIG_BOOT_HAVE_LOGGING=n
CONFIG_SIZE_OPTIMIZATIONS=y
```

## boot/zephyr/boards/nrf51dk_nrf51822.conf
```kconfig
# Due the small boot partition, we can't enable logging or the debug
# optimization level out off the box. You need to increase the boot
# partition size with a zephyr DTS overlay to make MCUboot's debug
# builds fit.
CONFIG_LOG=n
```

## boot/zephyr/boards/nrf52840_pca10059.conf
```kconfig
# The UART is used for Serial Recovery, so logging requires
# an RTT console, which is not available out of the box on this board.
# Disable logging.
CONFIG_LOG=n

# The build won't fit on the partition allocated for it without size
# optimizations.
CONFIG_SIZE_OPTIMIZATIONS=y

# Serial
CONFIG_SERIAL=y
CONFIG_UART_NRFX=y
CONFIG_UART_INTERRUPT_DRIVEN=y
CONFIG_UART_LINE_CTRL=y

# MCUBoot serial
CONFIG_GPIO=y
CONFIG_MCUBOOT_SERIAL=y
CONFIG_BOOT_SERIAL_GPIO_DETECT=y
CONFIG_BOOT_SERIAL_CDC_ACM=y
CONFIG_BOOT_SERIAL_DETECT_PORT="GPIO_1"
CONFIG_BOOT_SERIAL_DETECT_PIN=6

# Required by USB
CONFIG_MULTITHREADING=y

# USB
CONFIG_USB=y
CONFIG_USB_DEVICE_STACK=y
CONFIG_USB_DEVICE_PRODUCT="MCUBOOT"
CONFIG_USB_CDC_ACM=y
CONFIG_USB_COMPOSITE_DEVICE=n
CONFIG_USB_MASS_STORAGE=n
```

## boot/zephyr/boards/nrf52840dongle_nrf52840.conf
```kconfig
# The UART is used for Serial Recovery, so logging requires
# an RTT console, which is not available out of the box on this board.
# Disable logging.
CONFIG_LOG=n

# Serial
CONFIG_CONSOLE=n
CONFIG_SERIAL=y
CONFIG_UART_NRFX=n
CONFIG_UART_INTERRUPT_DRIVEN=y
CONFIG_UART_LINE_CTRL=y

# MCUBoot serial
CONFIG_GPIO=y
CONFIG_MCUBOOT_SERIAL=y
CONFIG_BOOT_SERIAL_CDC_ACM=y

# Required by USB
CONFIG_MULTITHREADING=y

CONFIG_NORDIC_QSPI_NOR=n
```

## boot/zephyr/boards/nrf52840dongle_nrf52840_bare.conf
```kconfig
# The UART is used for Serial Recovery, so logging requires
# an RTT console, which is not available out of the box on this board.
# Disable logging.
CONFIG_LOG=n

# Serial
CONFIG_CONSOLE=n
CONFIG_SERIAL=y
CONFIG_UART_NRFX=n
CONFIG_UART_INTERRUPT_DRIVEN=y
CONFIG_UART_LINE_CTRL=y

# MCUBoot serial
CONFIG_GPIO=y
CONFIG_MCUBOOT_SERIAL=y
CONFIG_BOOT_SERIAL_CDC_ACM=y

# Required by USB
CONFIG_MULTITHREADING=y

# USB
CONFIG_USB_DEVICE_STACK=y
CONFIG_USB_DEVICE_REMOTE_WAKEUP=n
CONFIG_USB_DEVICE_PRODUCT="MCUBOOT"

CONFIG_NORDIC_QSPI_NOR=n
```

## boot/zephyr/boards/nrf52_minimal_footprint.conf
```kconfig
# Minimal MCUBoot flash footprint configuration
# for nRF52832 SoC targets
# This is not recomendet configuration because of security and reliability
# reasons.


# Generated by Kconfiglib (https://github.com/ulfalizer/Kconfiglib)
CONFIG_BOOT_SIGNATURE_TYPE_ECDSA_P256=y
CONFIG_BOOT_SIGNATURE_KEY_FILE="root-ec-p256.pem"

# In any real project CONFIG_BOOT_VALIDATE_SLOT0 enabling is recommended
# by security reason.
# CONFIG_BOOT_VALIDATE_SLOT0 is not set

# In most of projects CONFIG_BOOT_UPGRADE_ONLY disabling is recommended
# by reliability reason.
CONFIG_BOOT_UPGRADE_ONLY=y

# CONFIG_BOARD_ENABLE_DCDC is not set
CONFIG_SOC_SERIES_NRF52X=y
CONFIG_SOC_NRF52832_QFAA=y
CONFIG_ARM=y
CONFIG_ARM_MPU=n
CONFIG_MAIN_STACK_SIZE=10240
CONFIG_THREAD_STACK_INFO=n
# CONFIG_TICKLESS_KERNEL is not set
CONFIG_FLASH=y

CONFIG_CONSOLE=n
CONFIG_DEBUG=n
CONFIG_EARLY_CONSOLE=n
CONFIG_PRINTK=n

CONFIG_SYS_CLOCK_EXISTS=n

# Drivers and peripherals
CONFIG_I2C=n
CONFIG_WATCHDOG=n
CONFIG_GPIO=n
CONFIG_PINMUX=n
CONFIG_SPI=n
CONFIG_SERIAL=n

# Power management
CONFIG_PM=n

# Interrupts
CONFIG_DYNAMIC_INTERRUPTS=n
CONFIG_IRQ_OFFLOAD=n

# Memory protection
CONFIG_MEMORY_PROTECTION=n
CONFIG_THREAD_CUSTOM_DATA=n
CONFIG_FPU=n

# Boot
CONFIG_BOOT_BANNER=n
CONFIG_BOOT_DELAY=0

# Console
CONFIG_STDOUT_CONSOLE=n

# Build
CONFIG_SIZE_OPTIMIZATIONS=y
```

## boot/zephyr/boards/nrf54h20dk_nrf54h20_cpuapp_iron.conf
```kconfig
# Copyright (c) 2025 Nordic Semiconductor ASA
#
# SPDX-License-Identifier: Apache-2.0
#

# Ensure that the SPI NOR driver is disabled by default
CONFIG_SPI_NOR=n

CONFIG_BOOT_WATCHDOG_FEED=n

# Power domains forced on by default on boot, no need
# to manage them in bootloader.
CONFIG_POWER_DOMAIN=n
```

## boot/zephyr/boards/nrf54l15dk_nrf54l05_cpuapp.conf
```kconfig
# Copyright (c) 2024 Nordic Semiconductor ASA
#
# SPDX-License-Identifier: Apache-2.0
#

# Ensure that the SPI NOR driver is disabled by default
CONFIG_SPI_NOR=n

CONFIG_BOOT_WATCHDOG_FEED=n

# Ensure the fastest RRAM write operations
CONFIG_NRF_RRAM_WRITE_BUFFER_SIZE=32
```

## boot/zephyr/boards/nrf54l15dk_nrf54l10_cpuapp.conf
```kconfig
# Copyright (c) 2024 Nordic Semiconductor ASA
#
# SPDX-License-Identifier: Apache-2.0
#
CONFIG_BOOT_MAX_IMG_SECTORS=256

# Ensure that the SPI NOR driver is disabled by default
CONFIG_SPI_NOR=n

CONFIG_BOOT_WATCHDOG_FEED=n

# Ensure the fastest RRAM write operations
CONFIG_NRF_RRAM_WRITE_BUFFER_SIZE=32
```

## boot/zephyr/boards/nrf54l15pdk_nrf54l15_cpuapp.conf
```kconfig
# Copyright (c) 2024 Nordic Semiconductor ASA
#
# SPDX-License-Identifier: Apache-2.0
#
CONFIG_BOOT_WATCHDOG_FEED=n
```

## boot/zephyr/boards/nrf54lm20apdk_nrf54lm20a_cpuapp.conf
```kconfig
# Copyright (c) 2025 Nordic Semiconductor ASA
#
# SPDX-License-Identifier: Apache-2.0
#
CONFIG_BOOT_MAX_IMG_SECTORS=256

# Ensure that the SPI NOR driver is disabled by default
CONFIG_SPI_NOR=n

# TODO: below are not yet supported and need fixing
CONFIG_FPROTECT=n

CONFIG_BOOT_WATCHDOG_FEED=n

CONFIG_PSA_CRYPTO_DRIVER_CRACEN=n
CONFIG_PSA_CRYPTO_DRIVER_OBERON=y
```

## boot/zephyr/boards/nrf7002dk_nrf5340_cpuapp.conf
```kconfig
# By default no external SPI device is used for image storage,
# so SPI-NOR is not needed. This reduces size of MCUboot, remember
# though that when external image is needed the CONFIG_SPI_NOR
# has to be enabled.
CONFIG_SPI_NOR=n
```

## boot/zephyr/boards/rd_rw612_bga_rw612.conf
```kconfig
# Copyright 2024 NXP
# SPDX-License-Identifier: Apache-2.0

CONFIG_BOOT_MAX_IMG_SECTORS=1024
```

## boot/zephyr/boards/sparkfun_thing_plus_nrf9160.conf
```kconfig
# Disable Zephyr console
CONFIG_CONSOLE=n
CONFIG_CONSOLE_HANDLER=n
CONFIG_UART_CONSOLE=n

# Multithreading
CONFIG_MULTITHREADING=y

# MCUBoot settings
CONFIG_BOOT_MAX_IMG_SECTORS=256

# MCUboot serial recovery
CONFIG_MCUBOOT_SERIAL=y
CONFIG_BOOT_SERIAL_DETECT_PORT="GPIO_0"
CONFIG_BOOT_SERIAL_DETECT_PIN=12
CONFIG_BOOT_SERIAL_DETECT_PIN_VAL=0

# Size of mcuboot partition
CONFIG_SIZE_OPTIMIZATIONS=y
```

## boot/zephyr/boards/stm32h573i_dk.conf
```kconfig
CONFIG_BOOT_DIRECT_XIP=y
CONFIG_STM32_MEMMAP=y
CONFIG_BOOT_MAX_IMG_SECTORS_AUTO=n
CONFIG_BOOT_MAX_IMG_SECTORS=4096
```

## boot/zephyr/boards/stm32n6570_dk.conf
```kconfig
CONFIG_STM32_MEMMAP=y
CONFIG_BOOT_MAX_IMG_SECTORS_AUTO=n
CONFIG_BOOT_MAX_IMG_SECTORS=4096

# MCuboot is executed as FSBL in Load and Run mode
CONFIG_XIP=n
```
