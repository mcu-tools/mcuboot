## boot/zephyr/boards/thingy91_nrf52840.conf
```kconfig
# Disable Zephyr console
CONFIG_LOG=n
CONFIG_CONSOLE=n
CONFIG_CONSOLE_HANDLER=n
CONFIG_UART_CONSOLE=n

# The build won't fit on the partition allocated for it without size
# optimizations.
CONFIG_SIZE_OPTIMIZATIONS=y
CONFIG_PM_PARTITION_SIZE_MCUBOOT=0x12000

# Serial
CONFIG_SERIAL=y
CONFIG_UART_NRFX=y
CONFIG_UART_INTERRUPT_DRIVEN=y
CONFIG_UART_LINE_CTRL=y

# MCUboot serial recovery
CONFIG_GPIO=y
CONFIG_MCUBOOT_SERIAL=y
CONFIG_BOOT_SERIAL_CDC_ACM=y
CONFIG_BOOT_SERIAL_DETECT_PORT="GPIO_1"
CONFIG_BOOT_SERIAL_DETECT_PIN=13
CONFIG_BOOT_SERIAL_DETECT_PIN_VAL=0

# Required by USB
CONFIG_MULTITHREADING=y

# USB
CONFIG_USB=y
CONFIG_USB_DEVICE_STACK=y
CONFIG_USB_DEVICE_PRODUCT="MCUBOOT"
CONFIG_USB_CDC_ACM=y
CONFIG_USB_COMPOSITE_DEVICE=y
CONFIG_USB_MASS_STORAGE=n
CONFIG_USB_DEVICE_MANUFACTURER="Nordic Semiconductor"
CONFIG_USB_DEVICE_VID=0x1915
CONFIG_USB_DEVICE_PID=0x520F
```

## boot/zephyr/boards/thingy91_nrf9160.conf
```kconfig
# Disable Zephyr console
CONFIG_CONSOLE=n
CONFIG_CONSOLE_HANDLER=n
CONFIG_UART_CONSOLE=n

# Disable Flash protection
CONFIG_FPROTECT=n

# MCUBoot settings
CONFIG_BOOT_MAX_IMG_SECTORS=256

# MCUboot serial recovery
CONFIG_MCUBOOT_SERIAL=y
CONFIG_BOOT_SERIAL_DETECT_PORT="GPIO_0"
CONFIG_BOOT_SERIAL_DETECT_PIN=26
CONFIG_BOOT_SERIAL_DETECT_PIN_VAL=0
```

## boot/zephyr/boards/tlsr9518adk80d_tlsr9518.conf
```kconfig
# Copyright 2022 Telink Semiconductor
# SPDX-License-Identifier: Apache-2.0

CONFIG_BOOT_MAX_IMG_SECTORS=4096
```

## boot/zephyr/boards/uart_detect.conf
```kconfig
CONFIG_MCUBOOT_SERIAL=y
CONFIG_BOOT_SERIAL_UART_DETECT=y

# Serial
CONFIG_SERIAL=y
CONFIG_UART_NRFX=y
CONFIG_UART_INTERRUPT_DRIVEN=y
CONFIG_UART_LINE_CTRL=y
CONFIG_UART_CONSOLE=n

CONFIG_MULTITHREADING=y
```

## boot/zephyr/sample.yaml
```yaml
sample:
  description: mcuboot test build sample
  name: mcuboot

tests:
  sample.bootloader.mcuboot:
    tags: bootloader_mcuboot
    platform_allow:
      - nrf52840dk/nrf52840
      - frdm_k64f
      - disco_l475_iot1
    integration_platforms:
      - nrf52840dk/nrf52840
      - frdm_k64f
      - disco_l475_iot1
  sample.bootloader.mcuboot.serial_recovery:
    extra_args: EXTRA_CONF_FILE=serial_recovery.conf
    platform_allow:  nrf52840dk/nrf52840
    integration_platforms:
      - nrf52840dk/nrf52840
    tags: bootloader_mcuboot
  sample.bootloader.mcuboot.usb_cdc_acm_recovery:
    tags: bootloader_mcuboot
    platform_allow:  nrf52840dongle/nrf52840
    extra_args:
      - EXTRA_CONF_FILE=./usb_cdc_acm_recovery.conf
      - DTC_OVERLAY_FILE="./usb_cdc_acm.overlay;app.overlay"
    integration_platforms:
      - nrf52840dongle/nrf52840
  sample.bootloader.mcuboot.usb_cdc_acm_recovery_log:
    extra_args: EXTRA_CONF_FILE=./usb_cdc_acm_log_recovery.conf
      DTC_OVERLAY_FILE="./boards/nrf52840_big.overlay;app.overlay"
    platform_allow:  nrf52840dk/nrf52840
    integration_platforms:
      - nrf52840dk/nrf52840
    tags: bootloader_mcuboot
  sample.bootloader.mcuboot.single_slot:
    extra_args: EXTRA_CONF_FILE=./single_slot.conf
      DTC_OVERLAY_FILE="./boards/nrf52840_single_slot.overlay;app.overlay"
    platform_allow:  nrf52840dk/nrf52840
    integration_platforms:
      - nrf52840dk/nrf52840
    tags: bootloader_mcuboot
  sample.bootloader.mcuboot.qspi_nor_slot:
    extra_args: DTC_OVERLAY_FILE="./boards/nrf52840dk_qspi_nor_secondary.overlay;app.overlay"
      EXTRA_CONF_FILE="./boards/nrf52840dk_qspi_nor.conf;./boards/nrf52840dk_qspi_secondary_boot.conf"
    platform_allow: nrf52840dk/nrf52840
    integration_platforms:
      - nrf52840dk/nrf52840
    tags: bootloader_mcuboot
  sample.bootloader.mcuboot.hooks_multi:
    extra_args: DTC_OVERLAY_FILE="./boards/nrf52840dk_ram_multi.overlay;app.overlay"
      EXTRA_CONF_FILE=./boards/nrf52840dk_hooks_sample_overlay.conf
      TEST_BOOT_IMAGE_ACCESS_HOOKS=Y
    platform_allow: nrf52840dk/nrf52840
    integration_platforms:
      - nrf52840dk/nrf52840
    tags: bootloader_mcuboot
  sample.bootloader.mcuboot.ram_load:
    extra_args: EXTRA_CONF_FILE=./ram_load.conf
    tags: bootloader_mcuboot
    platform_allow: mimxrt1020_evk
    integration_platforms:
      - mimxrt1020_evk
```

## boot/zephyr/tests/cobs/testcase.yaml
```yaml
tests:
  bootloader.mcuboot.boot_serial.cobs:
    platform_allow: native_sim
    integration_platforms:
      - native_sim
    tags: bootloader_mcuboot
```

## boot/zephyr/uuid/Kconfig
```kconfig
#
# Copyright (c) 2025 Nordic Semiconductor ASA
#
# SPDX-License-Identifier: Apache-2.0
#

if MCUBOOT_UUID_VID || MCUBOOT_UUID_CID

menu "Vendor and image Class UUIDs"

choice MCUBOOT_UUID_IMPLEMENTATION
	prompt "UUID checks implementation"
	default MCUBOOT_UUID_SINGLE_VID

config MCUBOOT_UUID_SINGLE_VID
	bool "Single VID and one CID per image"
	help
	  This implementation allows to specify a single, common Vendor UUID
	  (VID) for all images and a unique Class UUID (CID) for each image.

endchoice # MCUBOOT_UUID_IMPLEMENTATION

if MCUBOOT_UUID_SINGLE_VID

config MCUBOOT_UUID_VID_VALUE
	string "Vendor name"
	default ""
	help
	  The vendor unique identifier.
	  The following formats are supported:
	   - Domain name (i.e. amce.corp) used to generate RFC 9562 UUID5
	     identifier.
	   - Raw UUID (i.e. 12345678-1234-5678-1234-567812345678)
	   - Raw HEX UUID (i.e. 12345678123456781234567812345678)

if MCUBOOT_UUID_CID

image=0
rsource "Kconfig.uuid.template"
image=1
rsource "Kconfig.uuid.template"
image=2
rsource "Kconfig.uuid.template"
image=3
rsource "Kconfig.uuid.template"
image=4
rsource "Kconfig.uuid.template"

endif # MCUBOOT_UUID_CID

endif # MCUBOOT_UUID_SINGLE_VID

endmenu

endif # MCUBOOT_UUID_VID || MCUBOOT_UUID_CID
```

## boot/zephyr/uuid/Kconfig.uuid.template
```kconfig
#
# Copyright (c) 2025 Nordic Semiconductor ASA
#
# SPDX-License-Identifier: Apache-2.0
#

if UPDATEABLE_IMAGE_NUMBER > $(image)

config MCUBOOT_UUID_CID_IMAGE_$(image)_VALUE
	string "Image class name (image $(image))"
	default ""
	help
	  The image class unique identifier.
	  The following formats are supported:
	   - Image class name (i.e. nRF5340_door_lock_btperipheral).
	     This format requires MCUBOOT_UUID_VID_VALUE to be defined
	     as the VID UUID is used as the namespace for generating RFC 9562
	     UUID5 identifier.
	   - Raw UUID (i.e. 12345678-1234-5678-1234-567812345678)
	   - Raw HEX UUID (i.e. 12345678123456781234567812345678)

config MCUBOOT_UUID_CID_IMAGE_$(image)
	bool
	default y
	depends on MCUBOOT_UUID_CID_IMAGE_$(image)_VALUE != ""
	help
	  Helper symbol to simplify the active CId list generation.

endif # UPDATEABLE_IMAGE_NUMBER > $(image)
```

## samples/non-flash-source/zephyr/boards/mec172xevb_assy6906.conf
```kconfig
CONFIG_BOOT_IMAGE_EXECUTABLE_RAM_START=0x000C8000
CONFIG_BOOT_IMAGE_EXECUTABLE_RAM_SIZE=327680

CONFIG_AARDVARK_I2C_FLASH=y
CONFIG_I2C=y
```

## west.yml
```yaml
# Copyright (c) 2022 Legrand North America, LLC.
#
# SPDX-License-Identifier: Apache-2.0

# The west manifest file for Zephyr ecosystem development.
#
# Usage:
# west init -m https://github.com/mcu-tools/mcuboot --mr main $new_workspace
# cd $new && west update

manifest:
  version: "0.12"

  remotes:
    - name: zephyrproject
      url-base: https://github.com/zephyrproject-rtos
    - name: mcu-tools
      url-base: https://github.com/mcu-tools

  defaults:
    remote: mcu-tools

  projects:
    - name: zephyr
      revision: main
      remote: zephyrproject
      import:
        name-blocklist:
          - mcuboot

  self:
    path: mcuboot
```

## zephyr/samples/modules/mcuboot/mcuboot_external_config/boards/actinius_icarus.conf
```kconfig
# Disable Zephyr console
CONFIG_CONSOLE=n

# MCUBoot settings
CONFIG_BOOT_MAX_IMG_SECTORS=256

# MCUboot serial recovery
CONFIG_MCUBOOT_SERIAL=y
```

## zephyr/samples/modules/mcuboot/mcuboot_external_config/boards/mimxrt1170_evk_cm7.conf
```kconfig
# Copyright 2022 NXP
# SPDX-License-Identifier: Apache-2.0

CONFIG_BOOT_MAX_IMG_SECTORS=1024
CONFIG_BOOT_ERASE_PROGRESSIVELY=y
# Move swap provides better wear levelling, so use it by default
CONFIG_BOOT_SWAP_USING_MOVE=y
```

## zephyr/samples/modules/mcuboot/mcuboot_external_config/boards/sparkfun_thing_plus_nrf9160.conf
```kconfig
# Disable Zephyr console
CONFIG_CONSOLE=n

# Multithreading
CONFIG_MULTITHREADING=y

# MCUBoot settings
CONFIG_BOOT_MAX_IMG_SECTORS=256

# MCUboot serial recovery
CONFIG_MCUBOOT_SERIAL=y
CONFIG_BOOT_SERIAL_DETECT_DELAY=450
CONFIG_MCUBOOT_INDICATION_LED=y

# Size of mcuboot partition
CONFIG_SIZE_OPTIMIZATIONS=y
```

## zephyr/samples/modules/mcuboot/mcuboot_external_config/sample.yaml
```yaml
# Copyright (c) 2022 Legrand North America, LLC.
# SPDX-License-Identifier: Apache-2.0

sample:
  description: MCUBoot external config
  name: MCUBoot external config

tests:
  mcuboot.sample.modules.mcuboot.mcuboot_external_config:
    tags: bootloader_mcuboot
    platform_allow:  nrf52840dk_nrf52840 frdm_k64f disco_l475_iot1
    integration_platforms:
      - nrf52840dk_nrf52840
      - frdm_k64f
      - disco_l475_iot1
  mcuboot.sample.modules.mcuboot.serial_recovery:
    extra_args: OVERLAY_CONFIG=serial_recovery.conf
    platform_allow:  nrf52840dk_nrf52840
    integration_platforms:
      - nrf52840dk_nrf52840
    tags: bootloader_mcuboot
  mcuboot.sample.modules.mcuboot.usb_cdc_acm_recovery:
    tags: bootloader_mcuboot
    platform_allow:  nrf52840dongle_nrf52840
    extra_args: DTC_OVERLAY_FILE="./usb_cdc_acm.overlay;app.overlay"
    integration_platforms:
      - nrf52840dongle_nrf52840
  mcuboot.sample.modules.mcuboot.usb_cdc_acm_recovery_log:
    extra_args: OVERLAY_CONFIG=./usb_cdc_acm_log_recovery.conf
      DTC_OVERLAY_FILE="./boards/nrf52840_big.overlay;app.overlay"
    platform_allow:  nrf52840dk_nrf52840
    integration_platforms:
      - nrf52840dk_nrf52840
    tags: bootloader_mcuboot
  mcuboot.sample.modules.mcuboot.single_slot:
    extra_args: OVERLAY_CONFIG=./single_slot.conf
      DTC_OVERLAY_FILE="./boards/nrf52840_single_slot.overlay;app.overlay"
    platform_allow:  nrf52840dk_nrf52840
    integration_platforms:
      - nrf52840dk_nrf52840
    tags: bootloader_mcuboot
  mcuboot.sample.modules.mcuboot.qspi_nor_slot:
    extra_args: DTC_OVERLAY_FILE="./boards/nrf52840dk_qspi_nor_secondary.overlay;app.overlay"
      OVERLAY_CONFIG="./boards/nrf52840dk_qspi_nor.conf;./boards/nrf52840dk_qspi_secondary_boot.conf"
    platform_allow: nrf52840dk_nrf52840
    integration_platforms:
      - nrf52840dk_nrf52840
    tags: bootloader_mcuboot
  mcuboot.sample.modules.mcuboot.hooks_multi:
    extra_args: DTC_OVERLAY_FILE="./boards/nrf52840dk_ram_multi.overlay;app.overlay"
      OVERLAY_CONFIG=./boards/nrf52840dk_hooks_sample_overlay.conf
      TEST_BOOT_IMAGE_ACCESS_HOOKS=Y
    platform_allow: nrf52840dk_nrf52840
    integration_platforms:
      - nrf52840dk_nrf52840
    tags: bootloader_mcuboot
  mcuboot.sample.modules.mcuboot.ram_load:
    extra_args: OVERLAY_CONFIG=./ram_load.conf
    tags: bootloader_mcuboot
    platform_allow: mimxrt1020_evk
    integration_platforms:
      - mimxrt1020_evk
```

## zephyr/tests/subsys/mcuboot_app/main/testcase.yaml
```yaml
common:
  tags: mcuboot_tests
  platform_allow: nrf52840dk_nrf52840
  integration_platforms:
    - nrf52840dk_nrf52840

tests:
  mcuboot.mcuboot_app.main:
    skip: false
```

## zephyr/tests/subsys/mcuboot_util/caps/testcase.yaml
```yaml
common:
  tags: mcuboot_tests
  platform_allow: native_posix
  integration_platforms:
    - native_posix
  extra_args: MCUBOOT_SWAP_USING_SCRATCH=0

tests:
  mcuboot.mcuboot_utils.caps.VALIDATE_SLOT0:
    extra_configs:
      - CONFIG_BOOT_VALIDATE_SLOT0=y
  mcuboot.mcuboot_utils.caps.VALIDATE_SLOT0_ONCE:
    extra_configs:
      - CONFIG_BOOT_VALIDATE_SLOT0_ONCE=y
  mcuboot.mcuboot_utils.caps.BOOT_UPGRADE_ONLY:
    extra_configs:
      - CONFIG_BOOT_UPGRADE_ONLY=y
  mcuboot.mcuboot_utils.caps.SINGLE_APPLICATION_SLOT:
    extra_configs:
      - CONFIG_SINGLE_APPLICATION_SLOT=y
  mcuboot.mcuboot_utils.caps.BOOT_SWAP_USING_MOVE:
    extra_configs:
      - CONFIG_BOOT_SWAP_USING_MOVE=y
  mcuboot.mcuboot_utils.caps.BOOT_DIRECT_XIP:
    extra_configs:
      - CONFIG_BOOT_DIRECT_XIP=y
  mcuboot.mcuboot_utils.caps.BOOT_DIRECT_XIP_REVERT:
    extra_configs:
      - CONFIG_BOOT_DIRECT_XIP_REVERT=y
  mcuboot.mcuboot_utils.caps.BOOT_RAM_LOAD:
    extra_configs:
      - CONFIG_BOOT_RAM_LOAD=y
  mcuboot.mcuboot_utils.caps.UPDATEABLE_IMAGE_NUMBER:
    skip: true  # test still under development
    extra_configs:
      - CONFIG_UPDATEABLE_IMAGE_NUMBER=0
  mcuboot.mcuboot_utils.caps.BOOT_SWAP_SAVE_ENCTLV:
    extra_configs:
      - CONFIG_BOOT_SWAP_SAVE_ENCTLV=y
```

## zephyr/tests/unit/mcuboot_app/os/testcase.yaml
```yaml
tests:
  mcuboot.mcuboot_app.os:
    skip: true  # Zephyr unittest does not include Kconfig from all modules
    type: unit
    extra_configs:
      - CONFIG_BOOT_USE_MBEDTLS=y
```

## zephyr/tests/unit/mcuboot_util/caps/testcase.yaml
```yaml
common:
  tags: mcuboot_tests
  platform_allow: native_posix
  integration_platforms:
    - native_posix
  extra_args: MCUBOOT_SWAP_USING_SCRATCH=0
  skip: true  # unittest does not generate DTS or process module Kconfigs!!

tests:
  mcuboot.mcuboot_utils.caps.unit.SIGN_RSA_2048:
    extra_args: MCUBOOT_SIGN_RSA=1 MCUBOOT_SIGN_RSA_LEN=2048
  mcuboot.mcuboot_utils.caps.unit.SIGN_RSA_3072:
    extra_args: MCUBOOT_SIGN_RSA=1 MCUBOOT_SIGN_RSA_LEN=3072
  mcuboot.mcuboot_utils.caps.unit.SIGN_EC:
    extra_args: MCUBOOT_SIGN_EC=1
  mcuboot.mcuboot_utils.caps.unit.SIGN_EC256:
    extra_args: MCUBOOT_SIGN_EC256=1
  mcuboot.mcuboot_utils.caps.unit.SIGN_ED25519:
    extra_args: MCUBOOT_SIGN_ED25519=1
  mcuboot.mcuboot_utils.caps.unit.OVERWRITE_ONLY:
    extra_args: MCUBOOT_OVERWRITE_ONLY=1
  mcuboot.mcuboot_utils.caps.unit.SWAP_USING_MOVE:
    extra_args: MCUBOOT_SWAP_USING_MOVE=1
  mcuboot.mcuboot_utils.caps.unit.SWAP_USING_SCRATCH:
    skip: true  # Behavior when OVERWRITE_ONLY and SWAP_USING_MOVE not defined
  mcuboot.mcuboot_utils.caps.unit.ENCRYPT_RSA:
    extra_args: MCUBOOT_ENCRYPT_RSA=1
  mcuboot.mcuboot_utils.caps.unit.ENCRYPT_KW:
    extra_args: MCUBOOT_ENCRYPT_KW=1
  mcuboot.mcuboot_utils.caps.unit.ENCRYPT_EC256:
    extra_args: MCUBOOT_ENCRYPT_EC256=1
  mcuboot.mcuboot_utils.caps.unit.VALIDATE_PRIMARY_SLOT:
    extra_args: MCUBOOT_VALIDATE_PRIMARY_SLOT=1
  mcuboot.mcuboot_utils.caps.unit.DOWNGRADE_PREVENTION:
    extra_args: MCUBOOT_DOWNGRADE_PREVENTION=1
  mcuboot.mcuboot_utils.caps.unit.BOOTSTRAP:
    extra_args: MCUBOOT_BOOTSTRAP=1
  mcuboot.mcuboot_utils.caps.unit.AES_256:
    extra_args: MCUBOOT_AES_256=1
  mcuboot.mcuboot_utils.caps.unit.RAM_LOAD:
    extra_args: MCUBOOT_RAM_LOAD=1
  mcuboot.mcuboot_utils.caps.unit.DIRECT_XIP:
    extra_args: MCUBOOT_DIRECT_XIP=1
  mcuboot.mcuboot_utils.caps.unit.IMAGE_NUMBER_2:
    extra_args: MCUBOOT_IMAGE_NUMBER=2
```
