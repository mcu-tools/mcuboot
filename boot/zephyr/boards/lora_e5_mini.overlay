/ {
	chosen {
		zephyr,code-partition = &boot_partition;
	};
};

&boot_partition {
	reg = <0x00000000 0x10000>;
	// read-only;
};

&lpuart1 {
	pinctrl-0 = <&lpuart1_tx_pc1 &lpuart1_rx_pc0>;
	pinctrl-names = "default";
	current-speed = <115200>;
	status = "okay";
};
