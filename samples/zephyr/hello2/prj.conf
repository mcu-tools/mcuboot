## prj.conf
```kconfig
# Enable the console
CONFIG_CONSOLE_SHELL=y
CONFIG_KERNEL_SHELL=y

# Use the bootloader.
CONFIG_BOOT_HEADER=y
CONFIG_TEXT_SECTION_OFFSET=0x200
```

## frdm_k64f.overlay
```dts
/* DTS overlay file.
 * vim: ft=dts
 */

/ {
	chosen {
		zephyr,code-partition = &slot0_partition;
	};
};
```

## src/main.c
```c
/*
 * Copyright (c) 2012-2014 Wind River Systems, Inc.
 *
 * SPDX-License-Identifier: Apache-2.0
 */

#include <zephyr.h>
#include <misc/printk.h>

void main(void)
{
	printk("Upgraded hello! %s\n", CONFIG_ARCH);
}
```
