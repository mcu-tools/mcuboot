## CMakeLists.txt
```
# SPDX-License-Identifier: Apache-2.0

cmake_minimum_required(VERSION 3.20.0)

find_package(Zephyr REQUIRED HINTS $ENV{ZEPHYR_BASE})
project(non_flash_backend_app)

if(NOT DEFINED FROM_WHO)
  set(FROM_WHO Zephyr)
endif()

target_compile_definitions(app PRIVATE "-DMCUBOOT_HELLO_WORLD_FROM=\"${FROM_WHO}\"")

target_sources(app PRIVATE src/main.c)
```

## sample.yaml
```
sample:
  name: Runtime source target
  description: Application loaded from mcuboot using runtime source hooks
common:
  build_only: true
tests:
    sample.zephyr.runtime_source.app:
      tags: samples tests runtime_source
      platform_allow:
        - frdm_k64f
```

## prj.conf
```kconfig
CONFIG_BOOTLOADER_MCUBOOT=y

CONFIG_MCUBOOT_SIGNATURE_KEY_FILE="./bootloader/mcuboot/root-rsa-2048.pem"
```

## boards/frdm_k64f.overlay
```dts
/ {
    chosen {
        zephyr,code-partition = &slot0_partition;
    };
};
```

## src/main.c
```c
/*
 * Copyright (c) 2024 Intel Corporation
 *
 * SPDX-License-Identifier: Apache-2.0
 */

#include <zephyr/kernel.h>
#include <zephyr/sys/printk.h>

int main(void)
{
	printk("Hello World from %s on %s, slot %s!\n",
		   MCUBOOT_HELLO_WORLD_FROM, CONFIG_BOARD,
		   DT_PROP(DT_CHOSEN(zephyr_code_partition), label));
}
```
